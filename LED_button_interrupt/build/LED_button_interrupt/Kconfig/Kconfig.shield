## LED_button_interrupt/build/LED_button_interrupt/Kconfig/Kconfig.shield
```kconfig
osource "/home/ewout-laptop-ubuntu/ncs/v3.1.0/nrf/boards/shields/*/Kconfig.shield"
```

## Simon_Says/build/Kconfig/boards/Kconfig.defconfig
```kconfig
# Load Zephyr board defconfig descriptions.
osource "/home/ewout-laptop-ubuntu/ncs/v3.1.0/zephyr/boards/nordic/nrf54l15dk/Kconfig.defconfig"
```

## Simon_Says/build/Kconfig/boards/Kconfig.sysbuild
```kconfig
# Load Sysbuild board Kconfig descriptions.
osource "/home/ewout-laptop-ubuntu/ncs/v3.1.0/zephyr/boards/nordic/nrf54l15dk/Kconfig.sysbuild"
```
